VERSION ""

NS_ :

BS_:

BU_: XXX

BO_ 1517 SCC_SELECTED_LEAD_5ed: 8 SCC
 SG_ SELECTED_LONG_DIST : 4|14@1+ (0.00625,0) [0|102.39375] "m" XXX
 SG_ SELECTED_REL_SPEED : 19|11@1- (0.1,0) [-102.4|102.3] "m/s" XXX
